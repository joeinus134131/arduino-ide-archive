#include <Wire.h>
#include <Adafruit_GFX.h>
#include <Adafruit_SSD1306.h>

#define SCREEN_WIDTH 128
#define SCREEN_HEIGHT 64
#define OLED_RESET    -1
Adafruit_SSD1306 display(SCREEN_WIDTH, SCREEN_HEIGHT, &Wire, OLED_RESET);

// Bitmap Logo Star (Pastikan ukuran sesuai saat konversi, di sini diasumsikan 16x16)
const unsigned char star_bitmap [] PROGMEM = {
  0xFF, 0xFF, 0xFF, 0xFF, 0xFF, 0xFF, 0xFF, 0xFF, 0xFF, 0xFF, 0xFF, 0xFF,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 0xFF
};

// Struktur Data Lirik
struct LyricLine {
  unsigned long startTime;
  const char* text;
  int textSize;
};

// Update Array Lirik dengan timing yang lebih manusiawi (ms)
LyricLine starboyLyrics[] = {
  {0,     "I'm a", 1},
  {800,   "MOTHERF*CKIN'", 1},
  {1500,  "STARBOY", 2},
  {4500,  "Let a nigga brag Pitt", 1},
  {7500,  "Legend of the fall,", 1},
  {10000, "Took the year", 1},
  {11500, "like a bandit", 1},
  {13500, "Bought mama a crib", 1},
  {15500, "brand-new wagon", 1},
  {17500, "Now she lookin'", 1},
  {19000, "lavish...", 1},
  {21000, "CREATED BY:", 1}, // Pindah ke size 1 agar muat
  {22500, "IDNMakerspace", 2}
};

// WAJIB: Update jumlah lirik menjadi 13
int lyricCount = 13;

unsigned long songStartMillis;
int currentLyricIndex = -1;

void setup() {
  if(!display.begin(SSD1306_SWITCHCAPVCC, 0x3C)) { 
    for(;;);
  }
  display.clearDisplay();
  songStartMillis = millis(); 
}

void drawVisualizer() {
  // Visualizer di area paling bawah (y: 50-64)
  for(int i=0; i<SCREEN_WIDTH; i+=4) {
    int h = random(2, 12);
    display.fillRect(i, 64-h, 2, h, SSD1306_WHITE);
  }
}

void drawStarLogo(int x, int y) {
  // Gunakan parameter 16, 16 sesuai asumsi ukuran icon star
  display.drawBitmap(x, y, star_bitmap, 16, 16, SSD1306_WHITE);
}

void loop() {
  unsigned long currentMillis = millis() - songStartMillis;
  display.clearDisplay();

  // --- HEADER (AREA KUNING) ---
  display.setTextSize(1);
  display.setTextColor(SSD1306_WHITE);
  display.setCursor(0, 0);
  display.print("Playing: STARBOY - the Weekend");
  display.drawFastHLine(0, 14, 128, SSD1306_WHITE); // Garis pemisah area kuning

  // --- LOGIKA LIRIK ---
  for (int i = 0; i < lyricCount; i++) {
    if (currentMillis >= starboyLyrics[i].startTime) {
      currentLyricIndex = i;
    }
  }

  // --- TAMPILAN LIRIK (AREA BIRU) ---
  if (currentLyricIndex != -1) {
    display.setTextSize(starboyLyrics[currentLyricIndex].textSize);
    
    // yPos diatur minimal 20 agar masuk area biru sepenuhnya
    int yPos = (starboyLyrics[currentLyricIndex].textSize == 2) ? 28 : 22;
    display.setCursor(0, yPos);
    display.println(starboyLyrics[currentLyricIndex].text);
  }

  // --- EFEK VISUAL ---
  // Chorus Mode (Detik 15 - 18.5)
  if (currentMillis >= 15000 && currentMillis <= 18500) {
    if ((currentMillis / 150) % 2 == 0) { // Flicker effect
       drawStarLogo(100, 20); 
    }
  } else {
    drawVisualizer(); // Visualizer muncul di luar chorus
  }

  // Looping lagu (Ganti 22000 dengan durasi total yang diinginkan)
  if (currentMillis > 22000) {
    songStartMillis = millis();
    currentLyricIndex = -1;
  }

  display.display();
  delay(35); 
}